## Kconfig
```kconfig
config RTL8723CS
	tristate "Realtek RTL8723CS SDIO or SPI WiFi driver (2017)"
	depends on WLAN && MMC && CFG80211
	select WIRELESS_EXT
	select WEXT_PRIV
	help
    This option enables support for RTL8723CS SDIO drivers.
	If built as a module, it will be called 8723cs.
    
```
